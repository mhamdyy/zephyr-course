## app/boards/our_board_scratch/Kconfig
```kconfig
config HEAP_MEM_POOL_ADD_SIZE_BOARD
	int
	default 4096
	
config BOARD_OUR_BOARD_SCRATCH
    select BOARD_EARLY_INIT_HOOK
```

## app/boards/our_board_scratch/Kconfig.our_board_scratch
```kconfig
config BOARD_OUR_BOARD_COPY
	select SOC_ESP32S3_WROOM_N8
	select SOC_ESP32S3_PROCPU if BOARD_OUR_BOARD_COPY_ESP32S3_PROCPU
```

## boards/our_board_copy/board.yml
```yaml
board:
  name: our_board_copy
  full_name: Our Board Copy
  vendor: espressif
  socs:
  - name: esp32s3
```

## boards/our_board_scratch/Kconfig.our_board_scratch
```kconfig
config BOARD_OUR_BOARD_SCRATCH
    select SOC_ESP32S3_WROOM_N8
    select SOC_ESP32S3_PROCPU if BOARD_OUR_BOARD_SCRATCH_ESP32S3_PROCPU
```

## boards/our_board_scratch/board.yml
```yaml
board:
    name: our_board_scratch
    full_name: Our Board Scratch
    vendor: iomico
    socs:
    - name: esp32s3
```

## dts/bindings/our_driver.yaml
```yaml
description: Our custom sensor driving binding
compatible: "our,driver"
include: base.yaml
```
